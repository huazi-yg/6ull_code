#define n 100
/{
    virtual_intc: virtual_intc_100ask {
        compatible = "100ask,virt-intc";
        interrupt-controller;
        #interrupt-cells = <2>;

        interrupt-parent = <&intc>;
        interrupts = <n IRQ_TYPE_LEVEL_HIGH>;
    };

    gpio_keys {
        compatible = "100ask,gpio-keys";
        interrupt-parent = <&virtual_intc>;
        interrupts =    <0 IRQ_TYPE_LEVEL_HIGH>,
                        <1 IRQ_TYPE_LEVEL_HIGH>,
                        <2 IRQ_TYPE_LEVEL_HIGH>,
                        <3 IRQ_TYPE_LEVEL_HIGH>;
    };
};
