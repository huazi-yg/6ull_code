/ {
    input_dev_demo {
        compatible = "100ask,input_dev_demo";
        reg = <0x21b4000 16>;
        interrupt-parent = <&gpio1>;
        interrupts = <5 IRQ_TYPE_EDGE_FALLING | IRQ_TYPE_EDGE_RISING>;
    };
};